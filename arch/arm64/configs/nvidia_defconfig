## drivers/usb/misc/lstp/Kconfig
```kconfig
# SPDX-License-Identifier: GPL-2.0-only

config USB_LSTP
	tristate "LSTP USB adapter support"
	depends on USB
	depends on I2C
	depends on SPI_MASTER
	depends on GPIOLIB
	depends on LEDS_CLASS
	depends on TTY
	select GPIOLIB_IRQCHIP
	help
	  This adds support for the Low-Speed Transport Protocol (LSTP)
	  USB adapter. The LSTP adapter exposes firmware-configured I2C, SPI,
	  GPIO, UART, IPMI, and MMIO channels over a single USB interface.

	  This driver can also be built as a module. If so, the module will be
	  called lstp.

	  If unsure, say N.

config USB_LSTP_SPI_SPIDEV
	bool "Auto-create spidev devices for LSTP SPI channels"
	depends on USB_LSTP
	depends on SPI_SPIDEV
	help
	  Enable this option to make the lstp module default to creating spidev
	  child devices for SPI channels that do not have firmware-described
	  child devices.

	  This only sets the compile-time default for the auto_bind_spidev module
	  parameter. The default can still be overridden at module load time.

	  If unsure, say N.

config SEPARATE_LSTP_IPMI_POSTCODES
	bool "Separate LSTP IPMI post code writes to separate miscdevice"
	depends on USB_LSTP
	help
	  Enable this option to route IPMI post code writes to a separate
	  miscdevice instead of the main IPMI message path. Since POST codes
	  do not require a response, this allows faster processing by
	  bypassing the standard IPMI request-response handling.

	  If unsure, say N.
```

## drivers/virt/coco/arm-cca-guest/Kconfig
```kconfig
# SPDX-License-Identifier: GPL-2.0-only
#

config ARM_CCA_GUEST
	tristate "Arm CCA Guest driver"
	depends on ARM64
	select PCI_TSM if PCI
	select TSM_REPORTS
	select AUXILIARY_BUS
	help
	  The driver provides userspace interface to request an
	  attestation report from the Realm Management Monitor(RMM).
	  If the DA feature is supported, it also register with TSM framework.

	  If you choose 'M' here, this module will be called
	  arm-cca-guest.
```

## drivers/virt/coco/arm-cca-host/Kconfig
```kconfig
# SPDX-License-Identifier: GPL-2.0-only
#
# TSM (TEE Security Manager) host drivers
#
config ARM_CCA_HOST
	tristate "Arm CCA Host driver"
	depends on ARM64
	depends on PCI
	depends on KVM
	select PCI_TSM
	select KEYS
	select X509_CERTIFICATE_PARSER
	select AUXILIARY_BUS
	select CRYPTO_ECDSA
	select CRYPTO_RSA

	help
	  ARM CCA RMM firmware is the trusted runtime that enforces memory
	  isolation and security for confidential computing on ARM. This driver
	  provides the interface for communicating with RMM to support secure
	  device assignment.

	  If you choose 'M' here, this module will be called arm-cca-host.
```

## drivers/virt/coco/nvidia-firme/Kconfig
```kconfig
config NVIDIA_FIRME_GUEST
	tristate "NVIDIA FIRME attestation driver"
	depends on ARM64
	default m
	select TSM_REPORTS
	select TSM_MEASUREMENTS
	help
	  TSM report and measurement register backend for ARM FIRME (DEN0149)
	  on NVIDIA Grace (TH500) platforms. After a DRTM Secure Launch:

	  - FIRME_ATTEST_PAT_GET retrieves attestation tokens from PSC,
	    exposed via configfs at /sys/kernel/config/tsm/report/.
	  - FIRME_ATTEST_EXTEND extends measurement registers in PSC,
	    exposed via sysfs for GPU/device evidence binding.

	  If you choose 'M' here, this module will be called nvidia-firme.
```

## drivers/virt/rmeda/Kconfig
```kconfig
# SPDX-License-Identifier: GPL-2.0-only

config RMEDA_GUEST
	tristate "RMEDA Guest Library"
	depends on PCI && ARM64
```

## nvidia/Kconfig
```kconfig
# SPDX-License-Identifier: GPL-2.0-only
#
# NVIDIA Driver configuration
#

menuconfig NVIDIA_DRIVERS
	bool "NVIDIA Driver Support"
	default n
	help
	  Enable support for NVIDIA drivers.

	  This section contains NVIDIA-specific drivers that can be
	  built into the kernel or as loadable modules.

	  If you have NVIDIA hardware, say Y here to access the
	  configuration options for NVIDIA drivers.

if NVIDIA_DRIVERS

config NVIDIA_FS
	tristate "NVIDIA GPU Direct Storage (GDS) filesystem driver"
	default n
	depends on MODULES
	help
	  Support for NVIDIA GPU Direct Storage (GDS) filesystem driver.

	  This driver enables GPU Direct Storage capabilities, allowing
	  direct data transfers between storage and GPU memory, bypassing
	  CPU memory for improved performance in GPU computing workloads.

	  IMPORTANT: This driver requires NVIDIA proprietary driver symbols
	  from nvidia.ko which are only available at runtime. Therefore,
	  this driver can ONLY be built as a loadable module (=m), NOT
	  built-in (=y).

	  If you select Y (built-in), the kernel build will fail with
	  undefined symbol errors. Always choose M (module) instead.

	  If you have NVIDIA GPUs and want to enable GDS support, choose M
	  to build as a module. The module will be called nvidia-fs.

config NVIDIA_FS_STATS
	bool "Enable NVIDIA-FS statistics support"
	depends on NVIDIA_FS
	default y
	help
	  Enable statistics collection for NVIDIA-FS operations.

	  This provides detailed statistics about GDS operations
	  which can be useful for performance monitoring and debugging.

config NVIDIA_FS_RDMA
	bool "Enable NVIDIA-FS RDMA support"
	depends on NVIDIA_FS
	default y
	help
	  Enable RDMA (Remote Direct Memory Access) support for NVIDIA-FS.

	  This allows NVIDIA-FS to work with InfiniBand and other RDMA
	  capable networks for high-performance storage access.

config NVIDIA_FS_BATCH
	bool "Enable NVIDIA-FS batch operations support"
	depends on NVIDIA_FS
	default n
	help
	  Enable batch operations support for NVIDIA-FS.

	  This allows multiple I/O operations to be batched together
	  for improved performance.

config NVIDIA_FS_FAULT_INJECTION
	bool "Enable NVIDIA-FS fault injection support"
	depends on NVIDIA_FS && FAULT_INJECTION
	default n
	help
	  Enable fault injection support for NVIDIA-FS testing.

	  This is primarily useful for testing and debugging
	  NVIDIA-FS error handling paths.

endif # NVIDIA_DRIVERS
```
