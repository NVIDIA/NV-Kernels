## Documentation/devicetree/bindings/arm/arm,mpam-msc.yaml
```yaml
# SPDX-License-Identifier: GPL-2.0-only OR BSD-2-Clause
%YAML 1.2
---
$id: http://devicetree.org/schemas/arm/arm,mpam-msc.yaml#
$schema: http://devicetree.org/meta-schemas/core.yaml#

title: Arm Memory System Resource Partitioning and Monitoring (MPAM)

description: |
  The Arm MPAM specification can be found here:

  https://developer.arm.com/documentation/ddi0598/latest

maintainers:
  - Rob Herring <robh@kernel.org>

properties:
  compatible:
    items:
      - const: arm,mpam-msc                   # Further details are discoverable
      - const: arm,mpam-memory-controller-msc

  reg:
    maxItems: 1
    description: A memory region containing registers as defined in the MPAM
      specification.

  interrupts:
    minItems: 1
    items:
      - description: error (optional)
      - description: overflow (optional, only for monitoring)

  interrupt-names:
    oneOf:
      - items:
          - enum: [ error, overflow ]
      - items:
          - const: error
          - const: overflow

  arm,not-ready-us:
    description: The maximum time in microseconds for monitoring data to be
      accurate after a settings change. For more information, see the
      Not-Ready (NRDY) bit description in the MPAM specification.

  numa-node-id: true # see NUMA binding

  '#address-cells':
    const: 1

  '#size-cells':
    const: 0

patternProperties:
  '^ris@[0-9a-f]$':
    type: object
    additionalProperties: false
    description: |
      RIS nodes for each RIS in an MSC. These nodes are required for each RIS
      implementing known MPAM controls

    properties:
      compatible:
        enum:
            # Bulk storage for cache
          - arm,mpam-cache
            # Memory bandwidth
          - arm,mpam-memory

      reg:
        minimum: 0
        maximum: 0xf

      cpus:
        $ref: '/schemas/types.yaml#/definitions/phandle-array'
        description:
          Phandle(s) to the CPU node(s) this RIS belongs to. By default, the parent
          device's affinity is used.

      arm,mpam-device:
        $ref: '/schemas/types.yaml#/definitions/phandle'
        description:
          By default, the MPAM enabled device associated with a RIS is the MSC's
          parent node. It is possible for each RIS to be associated with different
          devices in which case 'arm,mpam-device' should be used.

    required:
      - compatible
      - reg

required:
  - compatible
  - reg

dependencies:
  interrupts: [ interrupt-names ]

additionalProperties: false

examples:
  - |
    /*
    cpus {
        cpu@0 {
            next-level-cache = <&L2_0>;
        };
        cpu@100 {
            next-level-cache = <&L2_1>;
        };
    };
    */
    L2_0: cache-controller-0 {
        compatible = "cache";
        cache-level = <2>;
        cache-unified;
        next-level-cache = <&L3>;

    };

    L2_1: cache-controller-1 {
        compatible = "cache";
        cache-level = <2>;
        cache-unified;
        next-level-cache = <&L3>;

    };

    L3: cache-controller@30000000 {
        compatible = "arm,dsu-l3-cache", "cache";
        cache-level = <3>;
        cache-unified;

        ranges = <0x0 0x30000000 0x800000>;
        #address-cells = <1>;
        #size-cells = <1>;

        msc@10000 {
            compatible = "arm,mpam-msc";

            /* CPU affinity implied by parent cache node's  */
            reg = <0x10000 0x2000>;
            interrupts = <1>, <2>;
            interrupt-names = "error", "overflow";
            arm,not-ready-us = <1>;
        };
    };

    mem: memory-controller@20000 {
        compatible = "foo,a-memory-controller";
        reg = <0x20000 0x1000>;

        #address-cells = <1>;
        #size-cells = <1>;
        ranges;

        msc@21000 {
            compatible = "arm,mpam-memory-controller-msc", "arm,mpam-msc";
            reg = <0x21000 0x1000>;
            interrupts = <3>;
            interrupt-names = "error";
            arm,not-ready-us = <1>;
            numa-node-id = <1>;
        };
    };

    iommu@40000 {
        reg = <0x40000 0x1000>;

        ranges;
        #address-cells = <1>;
        #size-cells = <1>;

        msc@41000 {
            compatible = "arm,mpam-msc";
            reg = <0 0x1000>;
            interrupts = <5>, <6>;
            interrupt-names = "error", "overflow";
            arm,not-ready-us = <1>;

            #address-cells = <1>;
            #size-cells = <0>;

            ris@2 {
                compatible = "arm,mpam-cache";
                reg = <0>;
                // TODO: How to map to device(s)?
            };
        };
    };

    msc@80000 {
        compatible = "foo,a-standalone-msc";
        reg = <0x80000 0x1000>;

        clocks = <&clks 123>;

        ranges;
        #address-cells = <1>;
        #size-cells = <1>;

        msc@10000 {
            compatible = "arm,mpam-msc";

            reg = <0x10000 0x2000>;
            interrupts = <7>;
            interrupt-names = "overflow";
            arm,not-ready-us = <1>;

            #address-cells = <1>;
            #size-cells = <0>;

            ris@0 {
                compatible = "arm,mpam-cache";
                reg = <0>;
                arm,mpam-device = <&L2_0>;
            };

            ris@1 {
                compatible = "arm,mpam-memory";
                reg = <1>;
                arm,mpam-device = <&mem>;
            };
        };
    };

...
```

## drivers/net/ethernet/realtek/r8127/Kconfig
```kconfig
# SPDX-License-Identifier: GPL-2.0-only
################################################################################
#
# r8127 is the Linux device driver released for Realtek 10 Gigabit Ethernet
# controllers with PCI-Express interface.
#
# Copyright(c) 2025 Realtek Semiconductor Corp. All rights reserved.
#
# This program is free software; you can redistribute it and/or modify it
# under the terms of the GNU General Public License as published by the Free
# Software Foundation; either version 2 of the License, or (at your option)
# any later version.
#
# This program is distributed in the hope that it will be useful, but WITHOUT
# ANY WARRANTY; without even the implied warranty of MERCHANTABILITY or
# FITNESS FOR A PARTICULAR PURPOSE.  See the GNU General Public License for
# more details.
#
# You should have received a copy of the GNU General Public License along with
# this program; if not, see <http://www.gnu.org/licenses/>.
#
# Author:
# Realtek NIC software team <nicfae@realtek.com>
# No. 2, Innovation Road II, Hsinchu Science Park, Hsinchu 300, Taiwan
#
################################################################################

################################################################################
#  This product is covered by one or more of the following patents:
#  US6,570,884, US6,115,776, and US6,327,625.
################################################################################

config R8127
	tristate "RealTek RTL-8127 PCI 10 Gigabit Ethernet Adapter support"
	depends on PCI
	help
	  This is a driver for the 10 Gigabit Ethernet PCI network cards based on
	  the RTL-8127 chips. If you have one of those, say Y here.

	  To compile this driver as a module, choose M here: the module
	  will be called r8127. This is recommended.
```

## drivers/platform/arm64/Kconfig
```kconfig
# SPDX-License-Identifier: GPL-2.0-only

source "drivers/platform/arm64/ec/Kconfig"
```

## drivers/platform/arm64/mpam/Kconfig
```kconfig
config ARM64_MPAM_DRIVER
	bool
	default y if ARM64_MPAM
	select ACPI_MPAM if ACPI

config ARM64_MPAM_RESCTRL_FS
	bool
	default y if ARM64_MPAM_DRIVER && RESCTRL_FS
	select RESCTRL_RMID_DEPENDS_ON_CLOSID

menu "ARM64 MPAM driver options"

config ARM64_MPAM_DRIVER_DEBUG
	bool "Enable debug messages from the MPAM driver."
	help
	  Say yes here to enable debug messages from the MPAM driver.

config MPAM_KUNIT_TEST
	bool "KUnit tests for MPAM driver " if !KUNIT_ALL_TESTS
	depends on KUNIT=y
	default KUNIT_ALL_TESTS
	help
	  Enable this option to run tests in the MPAM driver.

	  If unsure, say N.

endmenu
```

## drivers/platform/arm64/nvidia/Kconfig
```kconfig
# SPDX-License-Identifier: GPL-2.0-only
#
# NVIDIA ARM64 Platform-Specific Device Drivers
#

config MTK_PCIE_HOTPLUG
	tristate "CX7 PCIe Hotplug Driver"
	depends on EINT_MTK
	depends on PCI && ACPI
	help
	  Say Y here to support PCIe device plug in/out detection.
	  It will disable PCIe link when plug out and enable
	  PCIe link after plug in.

	  This is particularly useful for GB10 SoC.

	  If unsure, say N.
```

## drivers/platform/mpam/Kconfig
```kconfig
# Confusingly, this is everything but the CPU bits of MPAM. CPU here means
# CPU resources, not containers or cgroups etc.
config ARM_CPU_RESCTRL
	bool
	default y
	depends on ARM64 && ARCH_HAS_CPU_RESCTRL
	depends on MISC_FILESYSTEMS
	select RESCTRL_RMID_DEPENDS_ON_CLOSID
```

## drivers/vfio/pci/cxl/Kconfig
```kconfig
config VFIO_CXL_CORE
	bool "VFIO CXL core"
	depends on VFIO_PCI_CORE && CXL_BUS && CXL_MEM
	help
	    Extends vfio-pci-core with CXL.mem passthrough for vendor-specific
	    CXL devices (CXL_DEVTYPE_DEVMEM) that implement HDM-D or HDM-DB
	    decoders without the standard CXL memory expander class code
	    (PCI_CLASS_MEMORY_CXL).  Covers CXL Type-2 accelerators and
	    non-class-code Type-3 variants (e.g. compressed memory devices).
```

## fs/resctrl/Kconfig
```kconfig
config RESCTRL_FS
	bool "CPU Resource Control Filesystem (resctrl)"
	depends on ARCH_HAS_CPU_RESCTRL
	select KERNFS
	select PROC_CPU_RESCTRL if PROC_FS
	help
	  Some architectures provide hardware facilities to group tasks and
	  monitor and control their usage of memory system resources such as
	  caches and memory bandwidth.  Examples of such facilities include
	  Intel's Resource Director Technology (Intel(R) RDT) and AMD's
	  Platform Quality of Service (AMD QoS).

	  If your system has the necessary support and you want to be able to
	  assign tasks to groups and manipulate the associated resource
	  monitors and controls from userspace, say Y here to get a mountable
	  'resctrl' filesystem that lets you do just that.

	  If nothing mounts or prods the 'resctrl' filesystem, resource
	  controls and monitors are left in a quiescent, permissive state.

	  On architectures where this can be disabled independently, it is
	  safe to say N.

	  See <file:Documentation/filesystems/resctrl.rst> for more information.

config CGROUP_RESCTRL
	bool "cgroup controller for resctrl tasks"
	depends on RESCTRL_FS && CGROUPS
	help
	  Use cgroups to manage the task assignment to control and monitor
	  groups. This option adds a 'resctrl' controller which allows the
	  control or monitor group 'id' to be written to a cgroup. The tasks
	  in that cgroup are then part of the specified control or monitor
	  group. Creation and configuration of control and monitor groups
	  is still done through resctrl. This option requires the
	  'abi playground' mount option to resctrl, and is not to be relied on.

config RESCTRL_FS_PSEUDO_LOCK
	bool
	help
	  Software mechanism to pin data in a cache portion using
	  micro-architecture specific knowledge.

config RESCTRL_RMID_DEPENDS_ON_CLOSID
	bool
	help
	  Enabled by the architecture when the RMID values depend on the CLOSID.
	  This causes the CLOSID allocator to search for CLOSID with clean
	  RMID.

config RESCTRL_IOMMU
	bool
	help
	  Enabled by the architecture when some IOMMU are able to be configured
	  with CLOSID/RMID.
```
